## base_external/Config.in
```kconfig
menu "aesd-assignment configurations"

source "../base_external/package/aesd-assignments/Config.in"

endmenu
```

## base_external/package/ldd/Config.in
```kconfig
config BR2_PACKAGE_LDD
	bool "ldd"
	help
	  Installs misc-module and scull kernel modules into the root file system.
```
